#include atanumpad.dtsi

/ {
    kscan0: kscan0 {
        compatible = "zmk,kscan-gpio-matrix";
        wakeup-source;
        diode-direction = "col2row";

        col-gpios =
            <&pro_micro 5 GPIO_ACTIVE_HIGH>,
            <&pro_micro 4 GPIO_ACTIVE_HIGH>,
            <&pro_micro 20 GPIO_ACTIVE_HIGH>,
            <&pro_micro 19 GPIO_ACTIVE_HIGH>;

        row-gpios =
            <&pro_micro 2 (GPIO_ACTIVE_HIGH | GPIO_PULL_DOWN)>,
            <&gpio1 1 (GPIO_ACTIVE_HIGH | GPIO_PULL_DOWN)>,
            <&pro_micro 10 (GPIO_ACTIVE_HIGH | GPIO_PULL_DOWN)>,
            <&gpio1 2 (GPIO_ACTIVE_HIGH | GPIO_PULL_DOWN)>,
            <&pro_micro 16 (GPIO_ACTIVE_HIGH | GPIO_PULL_DOWN)>;
    };
};

&physical_layout_atanumpad {
    kscan = <&kscan0>;
};
